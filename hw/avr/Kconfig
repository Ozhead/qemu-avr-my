## hw/avr/Kconfig
```kconfig
config AVR_SAMPLE
    bool
    select AVR_TIMER16
    select AVR_USART
    select AVR_MASK
    select UNIMP
    select AVR_GPIO
```

## hw/ports/Kconfig
```kconfig
config AVR_GPIO
    bool

config AVR_PERIPHERAL
    bool

config AVR_PORT
    bool

config AVR_ADC
    bool

config AVR_UART
    bool

config AVR_TIMER_8b
	bool

config AVR_TIMER_16b
	bool
```
